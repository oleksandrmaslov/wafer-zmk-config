## config/hid-display/west.yml
```yaml
manifest:
  remotes:
    - name: zmkfirmware
      url-base: https://github.com/zmkfirmware
    - name: oleksandrmaslov
      url-base: https://github.com/oleksandrmaslov
  projects:
    - name: zmk
      remote: zmkfirmware
      revision: 4dd95d7840eb3d5a3f59bb29fbf1ab054715ef85
      import: app/west.yml
    - name: zmk-soft-off-plus
      remote: oleksandrmaslov
      revision: 42784a454ca21ccd46c99497cca6af7d0df4bf13
    - name: zmk-split-hid-display
      remote: oleksandrmaslov
      revision: b5c00042bce37f02b1b70b9e7d3b6913f013e7a6
  self:
    path: config/hid-display
```

## config/west.yml
```yaml
manifest:
  remotes:
    - name: zmkfirmware
      url-base: https://github.com/zmkfirmware
    # Keep the personal fork remote available in case we need to roll back.
    - name: oleksandrmaslov
      url-base: https://github.com/oleksandrmaslov
  projects:
    - name: zmk
      remote: zmkfirmware
      revision: main
      import: app/west.yml
    - name: zmk-soft-off-plus
      remote: oleksandrmaslov
      revision: 42784a454ca21ccd46c99497cca6af7d0df4bf13
    - name: zmk-split-hid-display
      remote: oleksandrmaslov
      revision: b5c00042bce37f02b1b70b9e7d3b6913f013e7a6
  self:
    path: config
```
