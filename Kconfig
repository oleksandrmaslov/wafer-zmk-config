## boards/arm/wafer/Kconfig
```kconfig
if BOARD_WAFER_LEFT || BOARD_WAFER_RIGHT

config BOARD_ENABLE_RETENTION
    bool "Enable retention feature"
    default y
    select RETAINED_MEM
    select RETENTION
    select RETENTION_BOOT_MODE

endif # BOARD_WAFER_LEFT || BOARD_WAFER_RIGHT
```

## boards/waferboard/wafer/Kconfig
```kconfig
rsource "Kconfig.wafer_left"
rsource "Kconfig.wafer_right"
rsource "Kconfig.defconfig"
```

## boards/waferboard/wafer/Kconfig.board
```kconfig
# Wafer board configuration

# Copyright (c) 2020 The ZMK Contributors
# SPDX-License-Identifier: MIT

choice
    prompt "Wafer Keyboard"
    depends on SOC_SERIES_NRF52X

config WAFER_LEFT
    bool "Wafer (Left)"
    select SOC_NRF52840_QIAA
        imply RETAINED_MEM
        imply RETENTION
        imply RETENTION_BOOT_MODE
        help
            Enable support for the board using the nRF52840 SoC.

config WAFER_RIGHT
    bool "Wafer (Right)"
    select SOC_NRF52840_QIAA
        imply RETAINED_MEM
        imply RETENTION
        imply RETENTION_BOOT_MODE
        help
            Enable support for the board using the nRF52840 SoC.

endchoice
```

## boards/waferboard/wafer/Kconfig.wafer_left
```kconfig
config BOARD_WAFER_LEFT
    bool "Wafer (Left)"
    select SOC_NRF52840_QIAA
    imply RETAINED_MEM
    imply RETENTION
    imply RETENTION_BOOT_MODE
    help
        Enable support for the left half of the Wafer split keyboard.
```

## boards/waferboard/wafer/Kconfig.wafer_right
```kconfig
config BOARD_WAFER_RIGHT
    bool "Wafer (Right)"
    select SOC_NRF52840_QIAA
    imply RETAINED_MEM
    imply RETENTION
    imply RETENTION_BOOT_MODE
    help
        Enable support for the right half of the Wafer split keyboard.
```

## boards/waferboard/wafer/board.yml
```yaml
boards:
  - name: wafer_left
    vendor: waferkeyboards
    socs:
      - name: nrf52840
  - name: wafer_right
    vendor: waferkeyboards
    socs:
      - name: nrf52840
```

## config/hid-display/west.yml
```yaml
manifest:
  remotes:
    - name: zmkfirmware
      url-base: https://github.com/zmkfirmware
    - name: oleksandrmaslov
      url-base: https://github.com/oleksandrmaslov
  projects:
    - name: zmk
      remote: zmkfirmware
      revision: 4dd95d7840eb3d5a3f59bb29fbf1ab054715ef85
      import: app/west.yml
    - name: zmk-soft-off-plus
      remote: oleksandrmaslov
      revision: e24d18023b72bca9a53e737decd1123851823c8e
    - name: zmk-split-hid-display
      remote: oleksandrmaslov
      revision: b5c00042bce37f02b1b70b9e7d3b6913f013e7a6
  self:
    path: config/hid-display
```

## config/west.yml
```yaml
manifest:
  remotes:
    - name: zmkfirmware
      url-base: https://github.com/zmkfirmware
    - name: oleksandrmaslov
      url-base: https://github.com/oleksandrmaslov
  projects:
    - name: zmk
      remote: zmkfirmware
      revision: 4dd95d7840eb3d5a3f59bb29fbf1ab054715ef85
      import: app/west.yml
    - name: zmk-soft-off-plus
      remote: oleksandrmaslov
      revision: e24d18023b72bca9a53e737decd1123851823c8e
  self:
    path: config
```

## dts/bindings/display/wafer,ls0xx-safe.yaml
```yaml
# Copyright (c) 2020 Rohit Gujarathi
# Copyright (c) 2026 Oleksandr Maslov
# SPDX-License-Identifier: Apache-2.0

description: Wafer-safe Sharp memory display controller

compatible: "wafer,ls0xx-safe"

include: [spi-device.yaml, display-controller.yaml]

properties:
  extcomin-gpios:
    type: phandle-array
    description: EXTCOMIN pin

      The EXTCOMIN pin receives a square pulse for toggling VCOM.

  extcomin-frequency:
    type: int
    description: EXTCOMIN pin toggle frequency

      The frequency with which the EXTCOMIN pin is toggled. See the
      datasheet for the particular display.

  disp-en-gpios:
    type: phandle-array
    description: DISPLAY pin

      The DISPLAY pin controls whether the LCD displays memory contents or
      a white screen. If defined, it is driven high during initialization.

  serial-vcom-inversion:
    type: boolean
    description: Send serial VCOM inversion commands

      Enable when EXTCOMIN is not connected and VCOM inversion is not
      managed by the application.

  serial-vcom-interval:
    type: int
    default: 1000
    description: Serial VCOM inversion interval in milliseconds

      This interval is used when EXTCOMIN is absent and serial VCOM
      inversion is enabled.
```

## modules/npm1300_vbat/Kconfig
```kconfig
# Copyright (c) 2026 Oleksandr Maslov
# SPDX-License-Identifier: MIT

rsource "drivers/Kconfig"
```

## modules/npm1300_vbat/drivers/sensor/npm1300_vbat/Kconfig
```kconfig
# SPDX-License-Identifier: MIT

config ZMK_NPM1300_VBAT
	bool "Nordic nPM1300 VBAT sensor (ZMK custom)"
	default y
	depends on DT_HAS_ZMK_NPM1300_VBAT_ENABLED
	select I2C
	help
	  Enable the ZMK custom sensor driver that triggers a VBAT measurement
	  on a Nordic nPM1300 PMIC and exposes the result on
	  SENSOR_CHAN_VOLTAGE in millivolts. SENSOR_CHAN_GAUGE_VOLTAGE is also
	  accepted for compatibility. Used together with
	  CONFIG_ZMK_BATTERY_REPORTING_FETCH_MODE_LITHIUM_VOLTAGE.
```

## modules/npm1300_vbat/dts/bindings/sensor/zmk,npm1300-vbat.yaml
```yaml
# SPDX-License-Identifier: MIT

description: |
  ZMK custom sensor driver that triggers a VBAT measurement on a Nordic
  nPM1300 PMIC and exposes the resulting voltage on
  SENSOR_CHAN_GAUGE_VOLTAGE (millivolts). Pair with
  CONFIG_ZMK_BATTERY_REPORTING_FETCH_MODE_LITHIUM_VOLTAGE so ZMK derives
  the battery percentage via the lithium curve.

compatible: "zmk,npm1300-vbat"

include: base.yaml

properties:
  pmic:
    type: phandle
    required: true
    description: |
      Phandle to the nPM1300 PMIC node (compatible "nordic,npm1300") that
      this sensor will drive ADC measurements on. The driver reuses the
      PMIC's i2c_dt_spec to issue ADC task and result reads.
```

## modules/wafer_ls0xx/Kconfig
```kconfig
# Copyright (c) 2020 Rohit Gujarathi
# SPDX-FileCopyrightText: Copyright The Zephyr Project Contributors
# Copyright (c) 2026 Oleksandr Maslov
# SPDX-License-Identifier: Apache-2.0

config WAFER_LS0XX_SAFE
	bool "Wafer-safe LS0xx memory display controller driver"
	default y
	depends on DISPLAY && DT_HAS_WAFER_LS0XX_SAFE_ENABLED
	select SPI
	help
	  Enable the Wafer-local Sharp LS0xx driver with serialized SPI/VCOM
	  access and balanced lock ownership.

config WAFER_LS0XX_VCOM_THREAD_PRIO
	int "Priority for the Wafer LS0xx VCOM inversion thread"
	default 11
	depends on WAFER_LS0XX_SAFE
	help
	  Set the priority of the periodic serial VCOM inversion thread.

config WAFER_LS0XX_VCOM_THREAD_STACK_SIZE
	int "Stack size for the Wafer LS0xx VCOM inversion thread"
	default 1024
	range 512 4096
	depends on WAFER_LS0XX_SAFE
	help
	  Stack size in bytes for the serial VCOM inversion thread.
```
