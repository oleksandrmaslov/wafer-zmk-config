/* SPDX-License-Identifier: MIT */

#include "wafer.dtsi"

&kscan0 {
    col-gpios = <&gpio1 14 GPIO_ACTIVE_HIGH>,
                <&gpio1 15 GPIO_ACTIVE_HIGH>,
                <&gpio1 6 GPIO_ACTIVE_HIGH>,
                <&gpio1 2 GPIO_ACTIVE_HIGH>,
                <&gpio0 8 GPIO_ACTIVE_HIGH>;
};
