/* SPDX-License-Identifier: MIT */

#include "wafer.dtsi"

&default_transform {
    col-offset = <5>;
};

&kscan0 {
    col-gpios = <&gpio0 8 GPIO_ACTIVE_HIGH>,
                <&gpio1 2 GPIO_ACTIVE_HIGH>,
                <&gpio1 6 GPIO_ACTIVE_HIGH>,
                <&gpio1 15 GPIO_ACTIVE_HIGH>,
                <&gpio1 14 GPIO_ACTIVE_HIGH>;
};
